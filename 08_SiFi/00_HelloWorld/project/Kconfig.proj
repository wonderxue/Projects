## 08_SiFi/00_HelloWorld/project/Kconfig.proj
```kconfig
#APP specific configuration.
config CUSTOM_MEM_MAP
    bool 
	select custom_mem_map
	default y if !SOC_SIMULATOR
	
config RT_SERIAL_DEFAULT_BAUDRATE
        int "UART default baudrate"
        default 115200
```

## 08_SiFi/00_HelloWorld/project/Kconfig.tmp
```kconfig
source "/Users/wonderxue/Desktop/SDKs/SiFli/customer/boards/cxk/hcpu/Kconfig.board"
source "$SIFLI_SDK/customer/boards/Kconfig.v2"
source "$SIFLI_SDK/Kconfig.v2"
orsource "sf-pkgs/Kconfig.conandeps"
rsource "Kconfig.proj"
```

## 08_SiFi/00_HelloWorld/project/build_cxk_hcpu/Kconfig
```kconfig
source "$SIFLI_SDK/Kconfig.v2"
source "$SIFLI_SDK/customer/boards/Kconfig.v2"
source "/Users/wonderxue/Desktop/SDKs/SiFli/customer/boards/cxk/hcpu/Kconfig.board"
osource "/Users/wonderxue/Desktop/Projects/08_SiFi/00_HelloWorld/project/sf-pkgs/Kconfig.conandeps"
source "/Users/wonderxue/Desktop/Projects/08_SiFi/00_HelloWorld/project/Kconfig.proj"
```

## 08_SiFi/01_Uart/project/build_cxk_hcpu/Kconfig
```kconfig
source "$SIFLI_SDK/Kconfig.v2"
source "$SIFLI_SDK/customer/boards/Kconfig.v2"
source "/Users/wonderxue/Desktop/SDKs/SiFli/customer/boards/cxk/hcpu/Kconfig.board"
osource "/Users/wonderxue/Desktop/Projects/08_SiFi/01_Uart/project/sf-pkgs/Kconfig.conandeps"
source "/Users/wonderxue/Desktop/Projects/08_SiFi/01_Uart/project/Kconfig.proj"
```

## 08_SiFi/01_Uart/project/build_cxk_hcpu/bootloader/Kconfig
```kconfig
source "$SIFLI_SDK/Kconfig.v2"
source "$SIFLI_SDK/customer/boards/Kconfig.v2"
source "/Users/wonderxue/Desktop/SDKs/SiFli/customer/boards/cxk/hcpu/Kconfig.board"
osource "/Users/wonderxue/Desktop/SDKs/SiFli/example/boot_loader/project/butterflmicro/ram_v2/sf-pkgs/Kconfig.conandeps"
source "/Users/wonderxue/Desktop/SDKs/SiFli/example/boot_loader/project/butterflmicro/ram_v2/Kconfig.proj"
```

## 08_SiFi/01_Uart/project/build_cxk_hcpu/ftab/Kconfig
```kconfig
source "$SIFLI_SDK/Kconfig.v2"
source "$SIFLI_SDK/customer/boards/Kconfig.v2"
source "/Users/wonderxue/Desktop/SDKs/SiFli/customer/boards/cxk/hcpu/Kconfig.board"
osource "/Users/wonderxue/Desktop/SDKs/SiFli/example/flash_table/sf32lb52x_common_v2/sf-pkgs/Kconfig.conandeps"
source "/Users/wonderxue/Desktop/SDKs/SiFli/example/flash_table/sf32lb52x_common_v2/Kconfig.proj"
```
