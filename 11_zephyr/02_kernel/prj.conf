## prj.conf
```kconfig
CONFIG_THREAD_ANALYZER=y
CONFIG_THREAD_RUNTIME_STATS=y
#可选：让系统自动、定期地打印分析结果
CONFIG_THREAD_ANALYZER_AUTO=y
CONFIG_THREAD_ANALYZER_AUTO_INTERVAL=5
# 确保USB设备在启动时初始化
CONFIG_USB_DEVICE_INITIALIZE_AT_BOOT=y
# 启用USB设备栈
CONFIG_USB_DEVICE_STACK=y

# 可选：设置USB设备描述符，让设备在主机上显示为友好的名称
CONFIG_USB_DEVICE_PRODUCT="Pico 2 USB Serial"
CONFIG_USB_DEVICE_VID=0x2E8A
CONFIG_USB_DEVICE_PID=0x000a

# 对于总线供电设备（如Pico 2），此项必须设为 'n'
CONFIG_USB_SELF_POWERED=n

# 确保USB设备在启动时初始化
CONFIG_USB_DEVICE_INITIALIZE_AT_BOOT=y

# 启用串行驱动器和控制台功能
CONFIG_SERIAL=y
CONFIG_CONSOLE=y
CONFIG_UART_CONSOLE=y

# 如果需要，可以启用日志功能
CONFIG_LOG=y
```

## app.overlay
```dts
	/
{
	chosen {
		zephyr,console = &cdc_acm_uart0;
		zephyr,shell-uart = &cdc_acm_uart0;
	};
};
	&usbd {
		cdc_acm_uart0:cdc_acm_uart0{
			compatible = "zephyr,cdc-acm-uart";
			label = "FUCK";
			status = "okay";
		};
	};
```

## src/main.c
```c
#include <zephyr/kernel.h>
#include <zephyr/sys/printk.h>

#define STACK_SIZE 1024

/* 定义堆栈空间 */
K_THREAD_STACK_DEFINE(thread1_stack, STACK_SIZE);
K_THREAD_STACK_DEFINE(thread2_stack, STACK_SIZE);

struct k_thread thread1_data;
struct k_thread thread2_data;

void thread1()
{
	while (1) {
        printk("Dynamic Thread 1\n");
        k_sleep(K_MSEC(100));
    }
}

void thread2()
{
	while (1) {
        printk("Dynamic Thread 2\n");
        k_sleep(K_MSEC(100));
    }

}

int main()
{
	k_thread_create(&thread1_data,thread1_stack,K_THREAD_STACK_SIZEOF(thread1_stack),
					thread1,NULL,NULL,NULL,50,0,K_NO_WAIT);
	k_thread_create(&thread2_data,thread2_stack,K_THREAD_STACK_SIZEOF(thread2_stack),
					thread2,NULL,NULL,NULL,50,0,K_MSEC(10000));
	while (1) {
        printk("main Thread\n");
        k_sleep(K_MSEC(1500));
    }
}
```
